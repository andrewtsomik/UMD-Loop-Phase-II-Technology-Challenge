## E2/west.yml
```yaml
manifest:
  remotes:
    - name: zephyrproject
      url-base: https://github.com/zephyrproject-rtos

  projects:
    - name: zephyr
      remote: zephyrproject
      revision: v4.4.0
      import:
        name-allowlist:
          - hal_espressif

  self:
    path: UMD-Loop-Phase-II-Technology-Challenge
```

## E2/zephyr-modules-main/modules/hex_led/dts/bindings/mycompany,hex-led.yaml
```yaml
compatible: "mycompany,hex-led"

description: Hex LED driver controlling three GPIO LEDs

properties:
  close-gpios:
    type: phandle-array
    required: true
    description: GPIO controlling the close LED
    specifier-space: gpio

  far-gpios:
    type: phandle-array
    required: true
    description: GPIO controlling the far LED
    specifier-space: gpio

  exact-gpios:
    type: phandle-array
    required: true
    description: GPIO controlling the exact LED
    specifier-space: gpio
```

## E2/zephyr-modules-main/modules/receiver/Kconfig
```kconfig
menuconfig RECEIVER
    bool "Receiver module"
    default y
    help
      Enable the external signal receiver module.

if RECEIVER

config RECEIVER_LOG_LEVEL
    int "Receiver log level"
    default 3
    range 0 4
    help
      Log level for the receiver module.
 
endif
```

## E2/zephyr-modules-main/modules/receiver/dts/bindings/mycompany,receiver.yaml
```yaml
description: "External UART signal receiver"

compatible: "mycompany,receiver"

properties:
  uart:
    type: phandle
    required: true
```

## E2/zephyr-modules-main/modules/servo/Kconfig
```kconfig
menuconfig SERVO
	bool "Servo driver"
	default y
	help
	  Enable the custom ESP32 LEDC servo driver.

if SERVO

config SERVO_INIT_PRIORITY
	int "Servo initialization priority"
	default 90
	help
	  Initialization priority for the servo driver.

endif
```

## E2/zephyr-modules-main/modules/servo/dts/bindings/mycompany,servo.yaml
```yaml
description: >
  Generic RC servo controlled by a PWM signal.

compatible: "mycompany,servo"

include: base.yaml

properties:
  pwms:
    type: phandle-array
    required: true
    description: PWM channel driving the servo signal line.

  min-pulse:
    type: int
    default: 1000
    description: >
      Minimum servo pulse width in microseconds.

  max-pulse:
    type: int
    default: 2000
    description: >
      Maximum servo pulse width in microseconds.

  min-angle:
    type: int
    default: 0
    description: >
      Minimum servo angle.

  max-angle:
    type: int
    default: 180
    description: >
      Maximum servo angle.
```

## E2/zephyr-modules-main/modules/tone/dts/bindings/mycompany,tone.yaml
```yaml
description: Tone generator

compatible: "mycompany,tone"

properties:
  pwms:
    type: phandle-array
    required: true
```
